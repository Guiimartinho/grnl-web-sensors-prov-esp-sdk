## sdkconfig.defaults
```kconfig
#
# system log
#
CONFIG_LOG_TIMESTAMP_SOURCE_SYSTEM=y
#CONFIG_ESP_CONSOLE_UART_CUSTOM=y
#CONFIG_ESP_CONSOLE_UART_CUSTOM_NUM_1=y
#CONFIG_ESP_CONSOLE_UART_NUM=1

#
# Set FreeRTOS Frequency
#
CONFIG_FREERTOS_HZ=1000

#
# Change UART Terminal Port
#
CONFIG_CONSOLE_UART_CUSTOM=y
CONFIG_CONSOLE_UART_CUSTOM_NUM_1=y
CONFIG_CONSOLE_UART_NUM=1
CONFIG_CONSOLE_UART_BAUDRATE=115200

CONFIG_EXAMPLE_UART_ISR_IN_RAM=y

#
# Necessary to fail cJSON
#
CONFIG_NEWLIB_NANO_FORMAT=n

#
# Serial Monitor
#
CONFIG_ESPTOOLPY_MONITOR_BAUD_74880B=n
CONFIG_ESPTOOLPY_MONITOR_BAUD=115200
CONFIG_ESPTOOLPY_MONITOR_BAUD_115200B=y
CONFIG_MONITOR_BAUD_115200B=y
CONFIG_MONITOR_BAUD=115200

#
# Disable WDT
#
CONFIG_ESP_TASK_WDT=n

#
# OTA
#
CONFIG_PARTITION_TABLE_TWO_OTA=y
CONFIG_NEWLIB_LIBRARY_LEVEL_NORMAL=y
CONFIG_MBEDTLS_SSL_OUT_CONTENT_LEN=1024
CONFIG_MBEDTLS_SSL_IN_CONTENT_LEN=16384

#
# Partition Table
#
CONFIG_PARTITION_TABLE_CUSTOM=y
CONFIG_PARTITION_TABLE_CUSTOM_FILENAME="partitions.csv"
CONFIG_PARTITION_TABLE_FILENAME="partitions.csv"
CONFIG_PARTITION_TABLE_CUSTOM_APP_BIN_OFFSET=0x8000
CONFIG_APP_OFFSET=0x8000
#CONFIG_PARTITION_TABLE_MD5=y

#
# broker
#
CONFIG_ESP_TLS_INSECURE=y
CONFIG_ESP_TLS_SKIP_SERVER_CERT_VERIFY=y

#
# Flash
#
CONFIG_ESPTOOLPY_FLASHSIZE_4MB=y
CONFIG_ESPTOOLPY_FLASHFREQ_80M=y

#
# File system
#
CONFIG_FATFS_LONG_FILENAME=y
CONFIG_FATFS_LFN_HEAP=y

#
# mDNS
#
CONFIG_MDNS_STRICT_MODE=y

#
# HTTP Server
#
CONFIG_HTTPD_MAX_REQ_HDR_LEN=1024

#
# LwIP
#
CONFIG_LWIP_LOCAL_HOSTNAME="grnl"
CONFIG_TCPIP_LWIP=y

CONFIG_LWIP_PPP_SUPPORT=y
CONFIG_LWIP_PPP_CHAP_SUPPORT=y
CONFIG_LWIP_PPP_MSCHAP_SUPPORT=y
CONFIG_LWIP_PPP_MPPE_SUPPORT=y
CONFIG_LWIP_PPP_DEBUG_ON=y
CONFIG_LWIP_MULTICAST_PING=y
CONFIG_LWIP_BROADCAST_PING=y

#
# Serial Flash
#
CONFIG_ESPTOOLPY_BAUD_2MB=y
CONFIG_ENABLE_MDNS=y

#
# SPIFFS Cache Configuration
#
CONFIG_USING_SPIFFS=y
CONFIG_SPIFFS_META_LENGTH=0
CONFIG_SPIFFS_GC_MAX_RUNS=10
CONFIG_SPIFFS_MAX_PARTITIONS=3
CONFIG_SPIFFS_OBJ_NAME_LEN=64
CONFIG_SPIFFS_PAGE_SIZE=256

# SPIFFS Cache Configuration
CONFIG_SPIFFS_CACHE=y
CONFIG_SPIFFS_CACHE_WR=y
CONFIG_SPIFFS_CACHE_STATS=n
CONFIG_SPIFFS_PAGE_CHECK=y
CONFIG_SPIFFS_GC_STATS=n
CONFIG_SPIFFS_USE_MAGIC=n
CONFIG_SPIFFS_USE_MAGIC_LENGTH=y
CONFIG_SPIFFS_USE_MTIME=y
CONFIG_SPIFFS_DBG=n
CONFIG_SPIFFS_API_DBG=n
CONFIG_SPIFFS_GC_DBG=n
CONFIG_SPIFFS_CACHE_DBG=n
CONFIG_SPIFFS_CHECK_DBG=n
CONFIG_SPIFFS_TEST_VISUALISATION=n

## MBED Config
#CONFIG_ESP_TLS_USING_MBEDTLS=y
#CONFIG_MBEDTLS_DEFAULT_MEM_ALLOC=y
#CONFIG_MBEDTLS_ASYMMETRIC_CONTENT_LEN=y
#CONFIG_MBEDTLS_SSL_IN_CONTENT_LEN=16384
#CONFIG_MBEDTLS_SSL_OUT_CONTENT_LEN=1024

# Override some defaults to enable PPP
CONFIG_ESP_NETIF_TCPIP_LWIP=y
CONFIG_LWIP_PPP_SUPPORT=y
CONFIG_LWIP_PPP_NOTIFY_PHASE_SUPPORT=y
CONFIG_LWIP_PPP_PAP_SUPPORT=y
CONFIG_LWIP_TCPIP_TASK_STACK_SIZE=4096
# Do not enable IPV6 in dte<->dce link local
CONFIG_LWIP_PPP_ENABLE_IPV6=n
```
